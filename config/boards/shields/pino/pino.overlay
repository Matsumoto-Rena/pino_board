/* pino.overlay - D2ピン単独テスト版 */
#include <dt-bindings/zmk/matrix_transform.h>

/ {
    chosen {
        zmk,kscan = &kscan0;
        zmk,matrix-transform = &default_transform;
    };

    /* 1キーだけ定義します */
    default_transform: keymap_transform_0 {
        compatible = "zmk,matrix-transform";
        columns = <1>;
        rows = <1>;
        map = < RC(0,0) >;
    };

    kscan0: kscan_0 {
        compatible = "zmk,kscan-gpio-direct";
        label = "KSCAN";
        /* 安全な D2ピン (P0.28) だけを使います。
           問題児の D0, D1 は使いません。
        */
        input-gpios
            = <&gpio0 28 (GPIO_ACTIVE_LOW | GPIO_PULL_UP)>; 
    };
};
