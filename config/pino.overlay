/ {
    chosen {
        zmk,kscan = &kscan0;
    };

    kscan0: kscan_0 {
        compatible = "zmk,kscan-gpio-direct";
        label = "KSCAN";
        input-gpios
            = <&xiao_d 0 (GPIO_ACTIVE_LOW | GPIO_PULL_UP)>  // SW1
            , <&xiao_d 1 (GPIO_ACTIVE_LOW | GPIO_PULL_UP)>  // SW2
            , <&xiao_d 2 (GPIO_ACTIVE_LOW | GPIO_PULL_UP)>  // SW3
            , <&xiao_d 3 (GPIO_ACTIVE_LOW | GPIO_PULL_UP)>  // SW4
            , <&xiao_d 4 (GPIO_ACTIVE_LOW | GPIO_PULL_UP)>  // SW5
            , <&xiao_d 5 (GPIO_ACTIVE_LOW | GPIO_PULL_UP)>  // SW6
            ;
    };
};
